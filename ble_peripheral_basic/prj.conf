## CMakeLists.txt
```
# SPDX-License-Identifier: Apache-2.0

cmake_minimum_required(VERSION 3.20.0)

find_package(Zephyr REQUIRED HINTS $ENV{ZEPHYR_BASE})
project(mtu_update)

target_sources(app PRIVATE
  src/main.c
  src/peripheral_mtu_update.c
)
target_include_directories(app PRIVATE inc)

zephyr_library_include_directories(${ZEPHYR_BASE}/samples/bluetooth)
```

## prj.conf
```kconfig
CONFIG_BT=y
CONFIG_BT_PERIPHERAL=y
CONFIG_BT_DEVICE_NAME="Jelly Broadcast Test"

CONFIG_LOG=y
CONFIG_BT_L2CAP_LOG_LEVEL_DBG=y

# HCI ACL buffers size
# BT_L2CAP_RX_MTU = CONFIG_BT_BUF_ACL_RX_SIZE - BT_L2CAP_HDR_SIZE
CONFIG_BT_BUF_ACL_RX_SIZE=251

# L2CAP SDU/PDU TX MTU
CONFIG_BT_L2CAP_TX_MTU=247
```

## src/main.c
```c
/* main.c - Application main entry point */

/*
 * Copyright (c) 2023 Nordic Semiconductor ASA
 *
 * SPDX-License-Identifier: Apache-2.0
 */

#include "peripheral_mtu_update.h"
#include "app_packet.h"

#include <stdint.h>
#include <stdbool.h>

#include <zephyr/kernel.h>
#include <zephyr/sys/printk.h>

static void gen_sample_ble_packet(ble_packet_t *pack) {
	pack->data.gesture += 1;
	pack->data.accel.x += 2;
	pack->data.accel.y += 2;
	pack->data.accel.z += 2;
	pack->data.gyro.x += 3;
	pack->data.gyro.y += 3;
	pack->data.gyro.z += 3;
}

int main(void)
{
	int i = 0;
	ble_packet_t packet = {0};

	send_peripheral_init();

	while (true) {
		gen_sample_ble_packet(&packet);
		send_peripheral_sample(packet.raw, sizeof(packet.raw), 0);
		printk("Sent BLE packet %d\n", i++);
		k_sleep(K_MSEC(100));
	}
	
	return 0;
}
```

## inc/peripheral_mtu_update.h
```c
#pragma once

#include <stdint.h>
#include <stddef.h>

int send_peripheral_init();
int send_peripheral_sample(uint8_t *notify_data, size_t notify_data_size, uint16_t seconds);
```
